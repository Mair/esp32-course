## _13_internet/_9_7_Rest_Send_SMS/main/Kconfig.projbuild
```kconfig
menu "WIFI CONNECT"

config WIFI_SSID
    string "SSID"
    default "my ssid"

config WIFI_PASSWORD
    string "PASSWORD"
    default "my password"  

endmenu

menu "TEL NUMBER"

config TEL_NUMBER
    string "TEL Number"
    default "+61404123456"  

endmenu
```

## _14_Rest_Client/_14_2_Rest_storing_data/main/Kconfig.projbuild
```kconfig
menu "WIFI CONNECT"

config WIFI_SSID
    string "SSID"
    default "my ssid"

config WIFI_PASSWORD
    string "PASSWORD"
    default "my password"  

endmenu
```

## _17_MQTT/MQTT_AWS/main/Kconfig.projbuild
```kconfig
menu "WIFI CONNECT"

config WIFI_SSID
    string "SSID"
    default "my ssid"

config WIFI_PASSWORD
    string "PASSWORD"
    default "my password"  

config AWS_IOT_THING_NAME
    string "AWS IoT Thing Name"
    default "ESP-AWS-IoT-Demo"
    help
        AWS IoT Thing Name

config AWS_IOT_CLIENT_ID
    string "AWS IoT Client ID"
    default "ESP32-CLIENT"
    help
        AWS IoT Client Name
endmenu
```

## _7_configuration_with_menuconfig/_6_2_custom_configuration/main/Kconfig.projbuild
```kconfig
menu "My Custom Menu"

config MY_BOOL
  bool "select yes or no"

config MY_STRING
  string "type something"
  default "hello world!"

config MY_INT
  int "type a number"
  default 3
  range 1 15
    help
      this is a numeric value

config MY_CHOICE
  choice
    bool "select a choice"
      default OPTION_1
    config OPTION_1
      bool "this is option 1"
    config OPTION_2
      bool "this is option 2"
    config OPTION_3
      bool "this is option 3"            
  endchoice


endmenu
```

## _7_configuration_with_menuconfig/_7_2_custom_configuration_defaults/main/Kconfig.projbuild
```kconfig
menu "My Custom Menu"

config MY_BOOL
    bool "select yes or no"

config MY_SECRET
    string "enter a secret"

config MY_STRING
    string "enter a string"
        help
            this is my help text description

config MY_INT
    int "in int"
    range 1 15

config MY_CHOICE
    choice
        bool "select a choice"
            default OPTION_1
        config OPTION_1
            bool "this is option 1"
        config OPTION_2
            bool "this is option 2"
        config OPTION_3
            bool "this is option 3"
    endchoice    


endmenu
```

## _9_storage/_9_6_spiffs-2_loop_files/sdkConfig.defaults
```kconfig
#
# Partition Table
#
# CONFIG_PARTITION_TABLE_SINGLE_APP is not set
# CONFIG_PARTITION_TABLE_SINGLE_APP_LARGE is not set
# CONFIG_PARTITION_TABLE_TWO_OTA is not set
CONFIG_PARTITION_TABLE_CUSTOM=y
CONFIG_PARTITION_TABLE_CUSTOM_FILENAME="partitions.csv"
CONFIG_PARTITION_TABLE_FILENAME="partitions.csv"
CONFIG_PARTITION_TABLE_OFFSET=0x8000
CONFIG_PARTITION_TABLE_MD5=y
# end of Partition Table


#
# Serial flasher config
#
# CONFIG_ESPTOOLPY_NO_STUB is not set
# CONFIG_ESPTOOLPY_FLASHMODE_QIO is not set
# CONFIG_ESPTOOLPY_FLASHMODE_QOUT is not set
CONFIG_ESPTOOLPY_FLASHMODE_DIO=y
# CONFIG_ESPTOOLPY_FLASHMODE_DOUT is not set
CONFIG_ESPTOOLPY_FLASH_SAMPLE_MODE_STR=y
CONFIG_ESPTOOLPY_FLASHMODE="dio"
# CONFIG_ESPTOOLPY_FLASHFREQ_80M is not set
CONFIG_ESPTOOLPY_FLASHFREQ_40M=y
# CONFIG_ESPTOOLPY_FLASHFREQ_26M is not set
# CONFIG_ESPTOOLPY_FLASHFREQ_20M is not set
CONFIG_ESPTOOLPY_FLASHFREQ="40m"
# CONFIG_ESPTOOLPY_FLASHSIZE_1MB is not set
# CONFIG_ESPTOOLPY_FLASHSIZE_2MB is not set
CONFIG_ESPTOOLPY_FLASHSIZE_4MB=y
# CONFIG_ESPTOOLPY_FLASHSIZE_8MB is not set
# CONFIG_ESPTOOLPY_FLASHSIZE_16MB is not set
# CONFIG_ESPTOOLPY_FLASHSIZE_32MB is not set
# CONFIG_ESPTOOLPY_FLASHSIZE_64MB is not set
# CONFIG_ESPTOOLPY_FLASHSIZE_128MB is not set
CONFIG_ESPTOOLPY_FLASHSIZE="4MB"
# CONFIG_ESPTOOLPY_HEADER_FLASHSIZE_UPDATE is not set
CONFIG_ESPTOOLPY_BEFORE_RESET=y
# CONFIG_ESPTOOLPY_BEFORE_NORESET is not set
CONFIG_ESPTOOLPY_BEFORE="default_reset"
CONFIG_ESPTOOLPY_AFTER_RESET=y
# CONFIG_ESPTOOLPY_AFTER_NORESET is not set
CONFIG_ESPTOOLPY_AFTER="hard_reset"
CONFIG_ESPTOOLPY_MONITOR_BAUD=115200
# end of Serial flasher config
```
